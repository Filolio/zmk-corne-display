## Kconfig
```kconfig
# Copyright (c) 2026
# SPDX-License-Identifier: MIT

menuconfig ZMK_CORNE_DISPLAY
    bool "Corne custom status screen"
    depends on ZMK_DISPLAY
    default y
    select LV_USE_LABEL
    imply LV_USE_THEME_MONO if LV_Z_BITS_PER_PIXEL=1
    imply ZMK_WIDGET_LAYER_STATUS
    imply ZMK_WIDGET_OUTPUT_STATUS
    imply ZMK_WIDGET_PERIPHERAL_STATUS
    help
      Custom ZMK status screen for the Corne shield.

      It keeps the standard widgets (output, layer, peripheral and
      optional WPM) and replaces the battery widget with one that
      draws the battery icon followed by the charge percentage.

if ZMK_CORNE_DISPLAY

config ZMK_CORNE_DISPLAY_ROTATED
    bool "Rotate the screen for a vertically mounted OLED"
    default y
    select LV_FONT_MONTSERRAT_10
    help
      The 128x32 SSD1306 is mounted vertically on some Corne builds.
      In that case the whole LVGL screen is rotated by 90 degrees:
      the logical resolution becomes 32x128 and the framebuffer is
      rotated back to the native 128x32 layout when flushed.

config ZMK_CORNE_DISPLAY_BATTERY_PERCENT
    bool "Show battery icon and percentage"
    default y
    help
      Draw a battery icon and the numeric charge percentage of the
      local half of the keyboard.

endif # ZMK_CORNE_DISPLAY
```
